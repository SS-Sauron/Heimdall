## main/Kconfig.projbuild
```kconfig
# =============================================================================
# main/Kconfig.projbuild
#
# Options defined here appear at the TOP LEVEL of `idf.py menuconfig`
# (not buried under "Component configuration"). This is the right place
# for project-wide feature gates that control multiple components.
#
# Reference: ESP-IDF build system docs — Kconfig.projbuild
# =============================================================================

menu "WoL Relay"

    # -------------------------------------------------------------------------
    # Build profile — the single switch that sets all defaults below.
    # Individual options can still be overridden in menuconfig after choosing
    # a profile; the profile just sets sane starting defaults.
    # -------------------------------------------------------------------------
    choice WOL_BUILD_PROFILE
        prompt "Build profile"
        default WOL_PROFILE_STANDARD
        help
            Selects the feature set compiled into the firmware.

            STANDARD:  Plug-and-play. Public MQTT broker over TLS,
                       MAC-in-payload dispatch, HMAC-derived topic,
                       captive portal for first-boot configuration.
                       No OPSEC compile-time features. Suitable for
                       publishing pre-built binaries via ESP Web Tools.

            HARDENED:  All OPSEC features enabled at compile time:
                       MAC spoofing, obfuscated DHCP hostname, TOTP-
                       signed payloads, HMAC topic derivation, response
                       channel confirmation.  Requires building from
                       source and managing your own signing keys.

            CUSTOM:    All features off by default. Configure each
                       option individually via menuconfig. For advanced
                       users who want a specific combination.

        config WOL_PROFILE_STANDARD
            bool "Standard (plug-and-play)"

        config WOL_PROFILE_HARDENED
            bool "Hardened (all OPSEC features)"

        config WOL_PROFILE_CUSTOM
            bool "Custom (configure manually)"

    endchoice

    # -------------------------------------------------------------------------
    # Factory reset gesture
    # Long-press duration for the BOOT button to trigger NVS wipe + reboot
    # into portal mode. Prevents accidental reset.
    # -------------------------------------------------------------------------
    config WOL_FACTORY_RESET_HOLD_MS
        int "Factory reset hold duration (ms)"
        default 5000
        range 3000 15000
        help
            How long (in milliseconds) the BOOT button must be held to
            trigger a factory reset. 5000 ms = 5 seconds.
            The device wipes all NVS credentials and reboots into
            captive portal mode.

    # -------------------------------------------------------------------------
    # Response channel
    # Publish a confirmation MQTT message after each Magic Packet is sent.
    # This closes the feedback loop — the trigger script knows the relay
    # received and acted on the command.
    # -------------------------------------------------------------------------
    config WOL_RESPONSE_CHANNEL
        bool "Enable MQTT response channel"
        default y
        help
            When enabled, the ESP32 publishes a confirmation message to a
            separate response topic every time it broadcasts a Magic Packet.
            The response includes the target MAC address, a timestamp, and
            a status code.

            The response topic is derived the same way as the command topic
            (HMAC if OPSEC is on, plain string if not).

    # -------------------------------------------------------------------------
    # Serial provisioning output
    # Print portal password and HMAC topic to serial on first boot.
    # Should be disabled for any device leaving your physical possession.
    # -------------------------------------------------------------------------
    config WOL_SERIAL_PROVISION_INFO
        bool "Print provisioning info to serial console on first boot"
        default y
        help
            Prints the portal AP password (and HMAC topic if hardened build)
            to the serial console during first boot. Useful for initial setup.
            Disable this option before distributing devices to others or
            deploying in shared physical spaces.

endmenu
```

## sdkconfig.defaults
```kconfig
# =============================================================================
# wol_relay — sdkconfig.defaults
# Applied automatically on first build when no sdkconfig file exists yet.
# Users can override anything here via:  idf.py menuconfig
# =============================================================================

# -----------------------------------------------------------------------------
# Target & Flash
# Change CONFIG_IDF_TARGET if building for ESP32-S3, ESP32-C3, etc.
# -----------------------------------------------------------------------------
CONFIG_IDF_TARGET="esp32"
CONFIG_ESPTOOLPY_FLASHSIZE_4MB=y
CONFIG_ESPTOOLPY_FLASHMODE_DIO=y
CONFIG_ESPTOOLPY_FLASHFREQ_80M=y

# -----------------------------------------------------------------------------
# Partition Table
# Points to our custom partitions.csv at project root.
# -----------------------------------------------------------------------------
CONFIG_PARTITION_TABLE_CUSTOM=y
CONFIG_PARTITION_TABLE_CUSTOM_FILENAME="partitions.csv"
CONFIG_PARTITION_TABLE_OFFSET=0x8000

# -----------------------------------------------------------------------------
# FreeRTOS
# 1000 Hz tick gives ms-precision for TOTP window checking.
# -----------------------------------------------------------------------------
CONFIG_FREERTOS_HZ=1000
CONFIG_FREERTOS_TASK_FUNCTION_WRAPPER=n

# -----------------------------------------------------------------------------
# Logging
# INFO in standard builds; change to DEBUG during development.
# -----------------------------------------------------------------------------
CONFIG_LOG_DEFAULT_LEVEL_INFO=y
CONFIG_LOG_MAXIMUM_LEVEL_DEBUG=y

# -----------------------------------------------------------------------------
# WiFi
# Reasonable buffer defaults for a single-connection relay device.
# -----------------------------------------------------------------------------
CONFIG_ESP_WIFI_STATIC_RX_BUFFER_NUM=6
CONFIG_ESP_WIFI_DYNAMIC_RX_BUFFER_NUM=16
# Disable WiFi NVS storage — we manage credentials ourselves in the
# storage component so we control the NVS namespace and key names.
CONFIG_ESP_WIFI_NVS_ENABLED=n
# Slow-path absolute timeout: 30 minutes per boot session, up to 7 consecutive
# reboot cycles (≈ 3.5 hours total) before credentials are erased.
CONFIG_WIFI_STA_ABSOLUTE_TIMEOUT_MINUTES=30
CONFIG_WIFI_STA_ABSOLUTE_TIMEOUT_MAX_REBOOTS=7

# -----------------------------------------------------------------------------
# MQTT (esp-mqtt native component)
# -----------------------------------------------------------------------------
CONFIG_MQTT_PROTOCOL_311=y
CONFIG_MQTT_TRANSPORT_SSL=y
CONFIG_MQTT_TRANSPORT_WEBSOCKET=n
CONFIG_MQTT_RELAY_TASK_STACK_KB=8

# -----------------------------------------------------------------------------
# Bootloader
# Log level set to WARN to minimise serial output on production devices.
# Set to INFO or DEBUG for development.
# -----------------------------------------------------------------------------
CONFIG_BOOTLOADER_LOG_LEVEL_WARN=y

# Enable OTA rollback so a failed firmware update reverts to the previous slot.
CONFIG_BOOTLOADER_APP_ROLLBACK_ENABLE=y
# Allow the OTA *client* to accept plain-HTTP firmware sources.
# NOTE: This does NOT start an OTA receiver server. Wireless OTA push
# (espota.py on port 3232) is planned but not yet implemented in the firmware.
# To update firmware, use the Web Flasher at https://ss-sauron.github.io/Heimdall/
# or run: idf.py build flash
CONFIG_OTA_ALLOW_HTTP=y


# -----------------------------------------------------------------------------
# WoL Relay build profile (defined in main/Kconfig.projbuild)
# STANDARD = plug-and-play defaults, no OPSEC compile-time features.
# Change to CONFIG_WOL_PROFILE_HARDENED=y for the security build.
# -----------------------------------------------------------------------------
CONFIG_WOL_PROFILE_STANDARD=y
```

## tests/opsec_test/components/opsec/Kconfig
```kconfig
menu "OPSEC Test Options"

    config OPSEC_TEST
        bool "Expose internal functions for unit testing"
        default y

    config OPSEC_HMAC_TOPIC
        bool "Enable HMAC topic test config"
        default y

    config OPSEC_TOTP
        bool "Enable TOTP test config"
        default y

    config OPSEC_TOTP_STEP_SEC
        int "TOTP time step in seconds"
        default 30
        range 15 60

    config OPSEC_TOTP_DIGITS
        int "TOTP code length"
        default 6
        range 6 8

endmenu
```

## tests/opsec_test/sdkconfig.defaults
```kconfig
# linux target — native host executable for unit testing
# CONFIG_IDF_TARGET is set by `idf.py set-target linux`; listed here for clarity.
CONFIG_OPSEC_TEST=y
CONFIG_OPSEC_HMAC_TOPIC=y
CONFIG_OPSEC_TOTP=y
CONFIG_OPSEC_TOTP_DIGITS=6
CONFIG_OPSEC_TOTP_STEP_SEC=30

# Use standard libc allocator for mbedTLS on the linux host target.
# This avoids the esp_mbedtls_mem_calloc/esp_mbedtls_mem_free symbols that
# are only provided by the ESP-IDF mbedtls port (unavailable on linux target).
CONFIG_MBEDTLS_DEFAULT_MEM_ALLOC=y
```
