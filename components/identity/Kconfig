## components/identity/Kconfig
```kconfig
menu "Identity Obfuscation"

    config OPSEC_IDENTITY_SPOOF_MAC
        bool "Spoof WiFi station MAC address"
        default y if WOL_PROFILE_HARDENED
        default n
        help
            Derives a locally-administered MAC address from the chip's
            burned-in eFuse base MAC using esp_derive_local_mac().

            The resulting MAC has bit 1 of the first octet set (locally
            administered bit) and does NOT resolve to Espressif in any
            OUI lookup table. This prevents passive network scanners from
            fingerprinting the device as an ESP32.

            Note: esp_wifi_set_mac() must be called while the WiFi driver
            is in INIT state (before esp_wifi_start()). The identity
            component handles this ordering automatically.

            Note: Cannot be enabled on ESP32-S2 and some C-series chips
            where the MAC is derived differently. Check your target's
            documentation if the build fails with ESP_ERR_NOT_SUPPORTED.

    config OPSEC_IDENTITY_FAKE_HOSTNAME
        bool "Use obfuscated DHCP hostname"
        default y if WOL_PROFILE_HARDENED
        default n
        help
            Replaces the default DHCP hostname (which contains "espressif"
            or "esp32") with a plausible consumer-device string derived
            from a hash of the chip MAC.

            Format: <PREFIX><6-char-hex-suffix>
            Example: "NETGEAR-A3F19C"

            The prefix is set by OPSEC_IDENTITY_HOSTNAME_PREFIX below.

    config OPSEC_IDENTITY_HOSTNAME_PREFIX
        string "Fake hostname prefix"
        default "NETGEAR-"
        depends on OPSEC_IDENTITY_FAKE_HOSTNAME
        help
            The prefix prepended to the 6-character hex MAC hash suffix.
            Choose something plausible for your network environment
            (e.g. "TP-LINK-", "DLINK-", "HUAWEI-").

            Keep it under 16 characters so the full hostname stays within
            the 32-character DHCP hostname limit.

endmenu
```

## components/mqtt_relay/Kconfig
```kconfig
menu "MQTT Relay"

    config MQTT_RELAY_KEEPALIVE_SEC
        int "MQTT keepalive interval (seconds)"
        default 60
        range 15 3600
        help
            How often the ESP32 sends a PINGREQ to the broker when idle.
            This keeps the TCP connection alive through NAT timeouts and
            tells the broker that the client is still alive.

            60 seconds is a good default.  Reduce if your broker or
            network has aggressive NAT timeout rules.

    config MQTT_RELAY_RECONNECT_TIMEOUT_MS
        int "MQTT reconnect timeout (ms)"
        default 5000
        range 1000 60000
        help
            Time the esp_mqtt_client waits before attempting to reconnect
            after a disconnection.  The client handles reconnection
            automatically; this controls the backoff delay.

    config MQTT_RELAY_TASK_STACK_KB
        int "MQTT client internal task stack size (KB)"
        default 8
        range 2 16
        help
            Stack size for the esp_mqtt_client internal FreeRTOS task.
            This is the task that calls mqtt_event_handler for every event.
            In the HARDENED build the handler runs TOTP (mbedTLS), opens a
            UDP socket, and calls esp_mqtt_client_publish — a deep call chain
            that requires at least 8 KB. 4 KB will cause a stack overflow.

    config MQTT_RELAY_SKIP_CERT_CN_CHECK
        bool "Skip TLS certificate common name check"
        default n
        help
            When enabled, the ESP32 does not verify that the broker's
            TLS certificate common name matches the broker hostname.
            This also disables TLS Server Name Indication (SNI), so it
            should not be used with hosted MQTT brokers such as HiveMQ
            Cloud.

            Enable only for loopback/debug brokers where hostname
            authentication and SNI are intentionally unnecessary.

    config WOL_LEGACY_RSP_TOPIC
        bool "Also publish to legacy /r response topic (backward compatibility)"
        default y
        help
            When enabled, all status messages are ALSO published to the
            old single response topic (wol/<mac>/r or the HARDENED
            equivalent without suffix) in addition to the new /s topic.

            Disable once all MQTT consumers have been updated to subscribe
            to the /s and /l topics instead.

    config WOL_GPIO_COMMANDS
        bool "Enable GPIO output control via MQTT"
        default n
        help
            When enabled, the relay accepts GPIO control commands on the
            same command topic as WoL commands. GPIO commands use a JSON
            payload with "action":"gpio". In HARDENED builds a valid TOTP
            code must also be present under a "totp" key.

            Payload format:
              STANDARD:  {"action":"gpio","pin":4,"level":1}
              HARDENED:  {"action":"gpio","pin":4,"level":1,"totp":123456}

    config WOL_GPIO_ALLOWED_PINS
        string "Comma-separated list of GPIO pins allowed for MQTT control"
        default "4,5"
        depends on WOL_GPIO_COMMANDS
        help
            Only pins listed here can be set via MQTT. This prevents a
            misconfigured or malicious command from toggling strapping pins
            (GPIO 0, 2, 12, 15) or UART/Flash pins.

            Default: GPIO 4 and GPIO 5 (safe general-purpose outputs).
            Example: "4,5,16,17"

endmenu
```

## components/opsec/Kconfig
```kconfig
menu "OPSEC Features"

    config OPSEC_HMAC_TOPIC
        bool "Use HMAC-derived opaque MQTT topics"
        default y if WOL_PROFILE_HARDENED
        default n
        help
            Derives the MQTT command and response topic names from
            HMAC-SHA256 of the chip MAC and a 32-byte secret stored
            in NVS.  The secret is generated randomly on first boot.

            Result: topics appear as 16-character hex strings
            (e.g. "d4f3a891c02e57b3") with no identifiable relation
            to Wake-on-LAN or to the device.

            Derivation:
              digest        = HMAC-SHA256(secret, chip_mac_bytes)
              command_topic = hex(digest[0..7])    // 16 hex chars
              response_topic= hex(digest[8..15])   // 16 hex chars

            In STANDARD builds the topics are plain strings:
              command_topic  = "wol/<MAC>"
              response_topic = "wol/<MAC>/r"

    config OPSEC_TOTP
        bool "Require TOTP-signed payloads (anti-replay)"
        default y if WOL_PROFILE_HARDENED
        default n
        depends on OPSEC_HMAC_TOPIC
        help
            Requires incoming MQTT payloads to include a valid
            RFC 6238 TOTP suffix in addition to the target MAC.

            Payload format (without TOTP):
              "AA:BB:CC:DD:EE:FF"

            Payload format (with TOTP):
              "AA:BB:CC:DD:EE:FF:123456"

            The 6-digit code is validated against a 20-byte TOTP
            seed stored in NVS (generated randomly on first boot).
            The acceptance window is T-1, T, T+1 (±60 seconds) to
            tolerate clock drift between the ESP32 and the sender.

            The ESP32 must have synchronized its clock via SNTP
            before TOTP validation is active.  Until clock sync,
            TOTP payloads are rejected and a warning is logged.

            The companion trigger script (scripts/wake_hardened.sh) handles
            TOTP generation automatically.

    config OPSEC_TOTP_STEP_SEC
        int "TOTP time step in seconds"
        default 30
        range 15 60
        depends on OPSEC_TOTP
        help
            Duration of each TOTP window.  RFC 6238 mandates 30 s.
            Matching the sender and the ESP32 to the same value is
            required — do not change unless you also update the
            trigger script.

    config OPSEC_TOTP_DIGITS
        int "TOTP code length (digits)"
        default 6
        range 6 8
        depends on OPSEC_TOTP
        help
            Number of digits in the TOTP code.  6 is the RFC 6238
            standard.  8 gives a larger code space but is less
            convenient to type manually.

    config OPSEC_SNTP_SERVER
        string "SNTP server hostname"
        default "pool.ntp.org"
        depends on OPSEC_TOTP
        help
            NTP server used to synchronise the ESP32 clock for TOTP
            validation.  pool.ntp.org resolves to the nearest
            Stratum 2 server.  Replace with a local NTP server or a
            trusted public one (e.g. "time.cloudflare.com") if
            preferred.

    config OPSEC_TEST
        bool "Expose internal functions for unit testing"
        default n
        help
            Exposes totp_at_counter_for_test() in opsec.h.
            Never enable in production builds.

endmenu
```

## components/portal/Kconfig
```kconfig
menu "Captive Portal"

    config PORTAL_AP_SSID_PREFIX
        string "SoftAP SSID prefix"
        default "NETGEAR-"
        help
            Prefix for the provisioning AP SSID. The last 6 characters are
            derived from a hash of the chip MAC so each device gets a unique
            name that looks like a real router.

            Keep this generic and plausible — use a common consumer router
            brand (e.g. "TP-LINK-", "DLINK-", "HUAWEI-").

            Max 26 characters so the full SSID stays within the 32-char limit.

    comment "The portal AP is always WPA2-protected by an eFuse-derived password"

    config PORTAL_AP_CHANNEL
        int "SoftAP WiFi channel"
        default 6
        range 1 13
        help
            WiFi channel for the provisioning AP. Channel 1, 6, or 11 are
            the standard non-overlapping 2.4 GHz channels.

    config PORTAL_AP_MAX_CONN
        int "Maximum simultaneous portal connections"
        default 1
        range 1 4
        help
            Number of devices that can connect to the portal AP at the same
            time. 1 is recommended — there is no reason for multiple devices
            to configure the relay simultaneously.

    config PORTAL_TIMEOUT_SEC
        int "Portal auto-close timeout in seconds (0 = never)"
        default 180
        range 0 3600
        help
            Seconds after boot before the portal automatically closes and the
            device reboots. If no credentials were entered, the device will
            just reboot back into portal mode again.

            0 disables the timeout — the portal stays open indefinitely.
            Useful for development; not recommended for deployment.

    config PORTAL_HTTP_PORT
        int "Portal HTTP server port"
        default 80
        range 1 65535
        help
            TCP port the portal HTTP server listens on. 80 is required for
            captive portal detection to work correctly on iOS and Android.

endmenu
```

## components/storage/Kconfig
```kconfig
menu "Storage"

    config STORAGE_NVS_NAMESPACE
        string "NVS namespace"
        default "wol"
        help
            The NVS namespace used to store all device credentials.
            Keep this short (max 15 chars). For an OPSEC-conscious
            deployment you may change this to a non-descriptive string
            (e.g. "d" or "cfg") so the namespace name gives no hint
            about the device's purpose to someone reading raw flash.

            Note: If you change this after devices have been provisioned
            the existing credentials become inaccessible (different
            namespace). Factory reset will be required.

endmenu
```

## components/wifi_sta/Kconfig
```kconfig
menu "WiFi Station"

    config WIFI_STA_MAX_RETRY
        int "Maximum connection retry attempts before giving up"
        default 10
        range 1 50
        help
            Number of times the WiFi station will attempt to reconnect
            after a disconnection event before logging a fatal error
            and rebooting. Each retry waits WIFI_STA_RETRY_DELAY_MS
            milliseconds before the next attempt.


    config WIFI_STA_ABSOLUTE_TIMEOUT_MINUTES
        int "Absolute disconnection ceiling before portal fallback (minutes)"
        default 30
        range 5 480
        help
            Maximum time (in minutes) the device will stay in a disconnected
            state within a single boot session before treating the situation
            as unresolvable. When this ceiling is hit the device increments
            a persistent reboot-strike counter in NVS and restarts. If the
            strike counter reaches WIFI_STA_ABSOLUTE_TIMEOUT_MAX_REBOOTS the
            device erases credentials and reboots into the provisioning portal.
            The timer restarts fresh on each boot; it does NOT accumulate
            across reboots.

    config WIFI_STA_ABSOLUTE_TIMEOUT_MAX_REBOOTS
        int "Maximum reboot cycles before erasing credentials (reboot-strike threshold)"
        default 7
        range 1 20
        help
            Number of consecutive 30-minute (WIFI_STA_ABSOLUTE_TIMEOUT_MINUTES)
            reboot cycles that must elapse before the device concludes the
            network configuration is permanently broken and erases credentials
            to force re-provisioning. At the default values (30 min × 7 = 210
            min ≈ 3.5 hours) the device gives genuine outages plenty of time to
            resolve on their own. The counter resets to zero the moment a
            successful IP address is obtained. Analogous to WIFI_STA_MAX_RETRY
            for the slow path.

endmenu
```

## components/wol/Kconfig
```kconfig
menu "Wake-on-LAN"

    config WOL_BROADCAST_PORT
        int "Magic Packet UDP port"
        default 9
        range 1 65535
        help
            UDP port the Magic Packet is sent to. Port 9 (discard) is the
            WoL standard and is what all PC BIOS/NIC implementations listen
            on by default. Only change this if your target PC's NIC or
            operating system requires a non-standard port.


endmenu
```
